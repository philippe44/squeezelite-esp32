## main/Kconfig.projbuild
```kconfig
menu "Squeezelite-ESP32"
	menu "Logging"
		config LOGGING_SLIMPROTO
        	string "logging level for slimproto "
        	default "info"
        	help
        		Set logging level info|debug|sdebug
		config LOGGING_STREAM
        	string "logging level for stream "
        	default "info"
        	help
        		Set logging level info|debug|sdebug
   		config LOGGING_DECODE
        	string "logging level for decode"
        	default "info"
        	help
        		Set logging level info|debug|sdebug 	
   		config LOGGING_OUTPUT
        	string "logging level for output"
        	default "info"
        	help
        		Set logging level info|debug|sdebug 	
        		
	endmenu
	config LOG_OPTION
		string "squeezelite log option"
		default "all=info"
		help 
			log=level	Set logging level, logs: all|slimproto|stream|decode|output, level: info|debug|sdebug
	menu "Wifi Configuration"
    config WIFI_SSID
        string "WiFi SSID"
        default "myssid"
        help
            SSID (network name) for the example to connect to.

    config WIFI_PASSWORD
        string "WiFi Password"
        default "mypassword"
        help
            WiFi password (WPA or WPA2) for the example to use.
  
    choice SCAN_METHOD
        prompt "scan method"
        default WIFI_FAST_SCAN
        help
            scan method for the esp32 to use

        config WIFI_FAST_SCAN
            bool "fast"
        config WIFI_ALL_CHANNEL_SCAN
            bool "all"
    endchoice

    choice SORT_METHOD
        prompt "sort method"
        default WIFI_CONNECT_AP_BY_SIGNAL
        help
            sort method for the esp32 to use

        config WIFI_CONNECT_AP_BY_SIGNAL
            bool "rssi"
        config WIFI_CONNECT_AP_BY_SECURITY
            bool "authmode"
    endchoice

    config FAST_SCAN_THRESHOLD
        bool "fast scan threshold"
        default y
        help
            wifi fast scan threshold

    config FAST_SCAN_MINIMUM_SIGNAL
        int "fast scan minimum rssi"
        depends on FAST_SCAN_THRESHOLD
        range -127 0
        default -127
        help
            rssi is use to measure the signal

    choice FAST_SCAN_WEAKEST_AUTHMODE
        prompt "fast scan weakest authmode"
        depends on FAST_SCAN_THRESHOLD
        default EXAMPLE_OPEN

        config EXAMPLE_OPEN
            bool "open"
        config EXAMPLE_WEP
            bool "wep"
        config EXAMPLE_WPA
            bool "wpa"
        config EXAMPLE_WPA2
            bool "wpa2"
    endchoice
    endmenu
    menu "Audio CODEC libraries"
    config INCLUDE_FLAC
        bool "FLAC"
        default 1
        help
            Include FLAC library for flc decoding.
    config INCLUDE_FAAD
        bool "FAAD"
        default 1
        help
            Include FAAD library for aac decoding.
    config INCLUDE_MAD
    	depends on SPIRAM_SUPPORT
        bool "MAD"
        default 1
        help
            Include mad library for mp3 decoding.
	config INCLUDE_VORBIS
        bool "VORBIS"
        default 1
        help
            Include vorbis/ogg library for ogg/vorbis decoding.			
	config INCLUDE_ALAC
        bool "ALAC"
        default 1
        help
            Include alac library for alac decoding.			
	   
    endmenu
	menu "Audio Output"
		choice OUTPUT_TYPE
	        prompt "Output Type"
	        default DACAUDIO
	        help
	            Type of output for squeezelite to send audio to
	        config DACAUDIO
	            bool "DAC over I2S"
	        config BTAUDIO
	            bool "Bluetooth A2DP"
	    endchoice
	    
	    config A2DP_SINK_NAME
	        string "Name of Bluetooth A2DP device"
	        depends on BTAUDIO
	        default "SMSL BT4.2"
	        help
	            This is the name of the bluetooth speaker that Squeezelite will try connecting to.
	   
	    config A2DP_DEV_NAME
	        string "Name of Squeezelite device to use when connecting to A2DP device"
	        depends on BTAUDIO
	        default "Squeezelite"
	        help
	            This is the name of the device that the Bluetooth speaker will see when it is connected to.
	    config A2DP_CONTROL_DELAY_MS
	        int "Control loop delay. "
	        depends on BTAUDIO
	        default 500
	        help
	            Decreasing this will lead to a more responsive BT control, but might lead to noisy log files if debug is enabled.
	    config A2DP_CONNECT_TIMEOUT_MS
	    	int "Time out duration when trying to connect to an A2DP audio sink"
			depends on BTAUDIO
	        default 1000
	        help
	            Increasing this value will give more chance for less stable connections to be established.	    		            
	            
	endmenu

endmenu
```

## sdkconfig.defaults
```kconfig
# Override some defaults so BT stack is enabled and
# BT and WiFi balance
CONFIG_ESP32_WIFI_AMPDU_TX_ENABLED=n
CONFIG_ESP32_WIFI_AMPDU_RX_ENABLED=n
CONFIG_SW_COEXIST_ENABLE=y
CONFIG_SW_COEXIST_PREFERENCE_BALANCE=y
CONFIG_SW_COEXIST_PREFERENCE_VALUE=2
# Classic BT is enabled
CONFIG_BT_ENABLED=y
CONFIG_BTDM_CONTROLLER_MODE_BLE_ONLY=
CONFIG_BTDM_CONTROLLER_MODE_BR_EDR_ONLY=y
CONFIG_BTDM_CONTROLLER_MODE_BTDM=
CONFIG_BLUEDROID_ENABLED=y
CONFIG_CLASSIC_BT_ENABLED=y
CONFIG_A2DP_ENABLE=y
CONFIG_BT_SPP_ENABLED=n
CONFIG_GATTS_ENABLE=n
CONFIG_GATTC_ENABLE=n
CONFIG_BLE_SMP_ENABLE=n
#enable SPIRAM
CONFIG_SPIRAM_SUPPORT=y
CONFIG_SPIRAM_BOOT_INIT=y
CONFIG_SPIRAM_USE_MALLOC=y
CONFIG_SPIRAM_TYPE_AUTO=y
CONFIG_SPIRAM_SIZE=-1
CONFIG_SPIRAM_SPEED_40M=y
CONFIG_SPIRAM_MEMTEST=y
CONFIG_SPIRAM_CACHE_WORKAROUND=y
CONFIG_SPIRAM_BANKSWITCH_ENABLE=y
CONFIG_SPIRAM_BANKSWITCH_RESERVE=8
CONFIG_SPIRAM_MALLOC_RESERVE_INTERNAL=32768
CONFIG_SPIRAM_MALLOC_ALWAYSINTERNAL=2048
CONFIG_PICO_PSRAM_CS_IO=10
CONFIG_MAIN_TASK_STACK_SIZE=8000
CONFIG_PARTITION_TABLE_CUSTOM=y
CONFIG_PARTITION_TABLE_CUSTOM_FILENAME="partitions.csv"
CONFIG_PARTITION_TABLE_FILENAME="partitions.csv"
CONFIG_PARTITION_TABLE_OFFSET=0x8000
CONFIG_PARTITION_TABLE_MD5=y
# CPU & threads options
CONFIG_ESP32_DEFAULT_CPU_FREQ_240=y
CONFIG_ESP32_DEFAULT_CPU_FREQ_MHZ=240
CONFIG_ESP32_DEFAULT_PTHREAD_CORE_NO_AFFINITY=
CONFIG_ESP32_DEFAULT_PTHREAD_CORE_0=
CONFIG_ESP32_DEFAULT_PTHREAD_CORE_1=y
CONFIG_ESP32_PTHREAD_TASK_CORE_DEFAULT=1
CONFIG_ESPTOOLPY_BAUD_2MB=y
CONFIG_ESPTOOLPY_BAUD=2000000
# Decreasing the delay here leads to a more responsive control of the playback.  
# If debug logging set on output, this should be raised as it will generate a lot of noise in logs 
CONFIG_A2DP_CONTROL_DELAY_MS=500
CONFIG_A2DP_CONNECT_TIMEOUT_MS=1000
```
